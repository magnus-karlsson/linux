## net/xdp/Kconfig
```kconfig
# SPDX-License-Identifier: GPL-2.0-only
config XDP_SOCKETS
	bool "XDP sockets"
	depends on BPF_SYSCALL
	default n
	help
	  XDP sockets allows a channel between XDP programs and
	  userspace applications.

config XDP_SOCKETS_DIAG
	tristate "XDP sockets: monitoring interface"
	depends on XDP_SOCKETS
	default n
	help
	  Support for PF_XDP sockets monitoring interface used by the ss tool.
	  If unsure, say Y.

config XDP_SOCKETS_USO_KUNIT_TEST
	tristate "AF_XDP USO header validation tests" if !KUNIT_ALL_TESTS
	depends on XDP_SOCKETS && KUNIT
	default KUNIT_ALL_TESTS
	help
	  KUnit tests for the helpers that validate and prepare AF_XDP UDP
	  segmentation offload (USO) requests in copy and zero-copy mode:
	  header validation, metadata snapshots, segment limits and the
	  preparation of headers and checksum seeds for segmentation.

	  If unsure, say N.
```
